## Config.in
```kconfig
source "$BR2_EXTERNAL_YARGOS_PATH/package/yarg/Config.in"
source "$BR2_EXTERNAL_YARGOS_PATH/package/yargos-bridge/Config.in"
```

## configs/yargos_x86_64_defconfig
```kconfig
# Architecture
BR2_x86_64=y
BR2_x86_corei7=y

# Faster rebuilds after a clean (cache lives in ~/.buildroot-ccache)
BR2_CCACHE=y
BR2_CCACHE_INITIAL_SETUP="--max-size=20G"

# Toolchain: YARG (Unity/Mono) needs glibc
BR2_TOOLCHAIN_BUILDROOT_GLIBC=y
BR2_TOOLCHAIN_BUILDROOT_CXX=y

# System
BR2_INIT_SYSTEMD=y
BR2_ROOTFS_MERGED_USR=y
BR2_SYSTEM_BIN_SH_BASH=y
BR2_TARGET_GENERIC_HOSTNAME="yargos"
BR2_TARGET_GENERIC_ISSUE="YARGOS"
BR2_TARGET_GENERIC_ROOT_PASSWD=""
BR2_ROOTFS_USERS_TABLES="$(BR2_EXTERNAL_YARGOS_PATH)/board/yargos/users.table"
BR2_ROOTFS_OVERLAY="$(BR2_EXTERNAL_YARGOS_PATH)/board/yargos/rootfs-overlay"
BR2_ROOTFS_POST_BUILD_SCRIPT="$(BR2_EXTERNAL_YARGOS_PATH)/board/yargos/post-build.sh"
BR2_ROOTFS_POST_IMAGE_SCRIPT="$(BR2_EXTERNAL_YARGOS_PATH)/board/yargos/post-image.sh"
BR2_PACKAGE_SYSTEMD_BOOT=y
BR2_PACKAGE_SYSTEMD_LOGIND=y
BR2_PACKAGE_SYSTEMD_NETWORKD=y
BR2_PACKAGE_SYSTEMD_RESOLVED=y
BR2_PACKAGE_SYSTEMD_TIMESYNCD=y
BR2_PACKAGE_LINUX_PAM=y
BR2_PACKAGE_ACL=y

# Kernel
BR2_LINUX_KERNEL=y
BR2_LINUX_KERNEL_LATEST_VERSION=y
BR2_LINUX_KERNEL_USE_ARCH_DEFAULT_CONFIG=y
BR2_LINUX_KERNEL_CONFIG_FRAGMENT_FILES="$(BR2_EXTERNAL_YARGOS_PATH)/board/yargos/linux.fragment"
BR2_LINUX_KERNEL_BZIMAGE=y
BR2_LINUX_KERNEL_INSTALL_TARGET=y

# Firmware: broad coverage so the image works on other AMD/Intel hardware
BR2_PACKAGE_LINUX_FIRMWARE=y
BR2_PACKAGE_LINUX_FIRMWARE_AMD_UCODE=y
BR2_PACKAGE_LINUX_FIRMWARE_AMDGPU=y
BR2_PACKAGE_LINUX_FIRMWARE_RADEON=y
BR2_PACKAGE_LINUX_FIRMWARE_I915=y
BR2_PACKAGE_LINUX_FIRMWARE_XE=y
BR2_PACKAGE_LINUX_FIRMWARE_INTEL_SST_DSP=y
BR2_PACKAGE_LINUX_FIRMWARE_IBT=y
BR2_PACKAGE_LINUX_FIRMWARE_RTL_87XX_BT=y
BR2_PACKAGE_LINUX_FIRMWARE_RTL_88XX_BT=y
BR2_PACKAGE_LINUX_FIRMWARE_MEDIATEK_MT7921_BT=y
BR2_PACKAGE_LINUX_FIRMWARE_MEDIATEK_MT7922_BT=y
BR2_PACKAGE_LINUX_FIRMWARE_MEDIATEK_MT7925_BT=y
BR2_PACKAGE_LINUX_FIRMWARE_QUALCOMM_6174A_BT=y
BR2_PACKAGE_LINUX_FIRMWARE_QUALCOMM_9377_BT=y
BR2_PACKAGE_LINUX_FIRMWARE_IWLWIFI_7260=y
BR2_PACKAGE_LINUX_FIRMWARE_IWLWIFI_7265=y
BR2_PACKAGE_LINUX_FIRMWARE_IWLWIFI_7265D=y
BR2_PACKAGE_LINUX_FIRMWARE_IWLWIFI_8000C=y
BR2_PACKAGE_LINUX_FIRMWARE_IWLWIFI_8265=y
BR2_PACKAGE_LINUX_FIRMWARE_IWLWIFI_9XXX=y
BR2_PACKAGE_LINUX_FIRMWARE_IWLWIFI_22000=y
BR2_PACKAGE_LINUX_FIRMWARE_IWLWIFI_6E=y
BR2_PACKAGE_LINUX_FIRMWARE_IWLWIFI_7=y
BR2_PACKAGE_LINUX_FIRMWARE_MEDIATEK_MT7921=y
BR2_PACKAGE_LINUX_FIRMWARE_MEDIATEK_MT7922=y
BR2_PACKAGE_LINUX_FIRMWARE_MEDIATEK_MT7925=y
BR2_PACKAGE_LINUX_FIRMWARE_RTL_81XX=y
BR2_PACKAGE_LINUX_FIRMWARE_RTL_87XX=y
BR2_PACKAGE_LINUX_FIRMWARE_RTL_88XX=y
BR2_PACKAGE_LINUX_FIRMWARE_RTL_RTW88=y
BR2_PACKAGE_LINUX_FIRMWARE_RTL_RTW89=y
BR2_PACKAGE_LINUX_FIRMWARE_RTL_8169=y
BR2_PACKAGE_LINUX_FIRMWARE_RTL_815X=y
BR2_PACKAGE_LINUX_FIRMWARE_ATHEROS_10K_QCA9377=y
BR2_PACKAGE_LINUX_FIRMWARE_ATHEROS_10K_QCA998X=y
BR2_PACKAGE_LINUX_FIRMWARE_QUALCOMM_WCN7850=y
BR2_PACKAGE_LINUX_FIRMWARE_BRCM_BCM43XX=y
BR2_PACKAGE_LINUX_FIRMWARE_BRCM_BCM43XXX=y
BR2_PACKAGE_LINUX_FIRMWARE_INTEL_ICE=y
BR2_PACKAGE_LINUX_FIRMWARE_IWLWIFI_3160=y
BR2_PACKAGE_LINUX_FIRMWARE_IWLWIFI_3168=y
BR2_PACKAGE_LINUX_FIRMWARE_IWLWIFI_6000G2A=y
BR2_PACKAGE_LINUX_FIRMWARE_IWLWIFI_6000G2B=y
BR2_PACKAGE_LINUX_FIRMWARE_IWLWIFI_22260=y
BR2_PACKAGE_LINUX_FIRMWARE_IWLWIFI_QUZ=y
BR2_PACKAGE_LINUX_FIRMWARE_MEDIATEK_MT7601U=y
BR2_PACKAGE_LINUX_FIRMWARE_MEDIATEK_MT7650=y
BR2_PACKAGE_LINUX_FIRMWARE_MEDIATEK_MT7610E=y
BR2_PACKAGE_LINUX_FIRMWARE_MEDIATEK_MT76X2E=y
BR2_PACKAGE_LINUX_FIRMWARE_RALINK_RT2XX=y
BR2_PACKAGE_LINUX_FIRMWARE_RALINK_RT61=y
BR2_PACKAGE_LINUX_FIRMWARE_RALINK_RT73=y
BR2_PACKAGE_LINUX_FIRMWARE_ATHEROS_9170=y
BR2_PACKAGE_LINUX_FIRMWARE_ATHEROS_9271=y
BR2_PACKAGE_LINUX_FIRMWARE_ATHEROS_7010=y
BR2_PACKAGE_INTEL_MICROCODE=y

# Graphics: Mesa (AMD radeonsi + RADV, Intel iris/anv, llvmpipe fallback) + Xorg
BR2_PACKAGE_MESA3D=y
BR2_PACKAGE_MESA3D_LLVM=y
BR2_PACKAGE_MESA3D_GALLIUM_DRIVER_RADEONSI=y
BR2_PACKAGE_MESA3D_GALLIUM_DRIVER_IRIS=y
BR2_PACKAGE_MESA3D_GALLIUM_DRIVER_LLVMPIPE=y
BR2_PACKAGE_MESA3D_VULKAN_DRIVER_INTEL=y
BR2_PACKAGE_MESA3D_VULKAN_DRIVER_SWRAST=y
BR2_PACKAGE_MESA3D_OPENGL_GLX=y
BR2_PACKAGE_MESA3D_OPENGL_EGL=y
BR2_PACKAGE_MESA3D_OPENGL_ES=y
BR2_PACKAGE_XORG7=y
BR2_PACKAGE_XSERVER_XORG_SERVER=y
BR2_PACKAGE_XDRIVER_XF86_VIDEO_AMDGPU=y
BR2_PACKAGE_XDRIVER_XF86_INPUT_LIBINPUT=y
BR2_PACKAGE_XAPP_XINIT=y
BR2_PACKAGE_XAPP_XSET=y
BR2_PACKAGE_XAPP_XRANDR=y
BR2_PACKAGE_XLIB_LIBXSCRNSAVER=y
BR2_PACKAGE_XLIB_LIBXINERAMA=y
BR2_PACKAGE_XLIB_LIBXCURSOR=y
BR2_PACKAGE_XLIB_LIBXI=y
BR2_PACKAGE_XLIB_LIBXRANDR=y
BR2_PACKAGE_XLIB_LIBXXF86VM=y
BR2_PACKAGE_LIBXKBCOMMON=y
BR2_PACKAGE_VULKAN_LOADER=y

# Input: hidapi/libusb are dlopen'd by YARG's HIDrogen plugin
BR2_PACKAGE_HIDAPI=y
BR2_PACKAGE_LIBUSB=y
BR2_PACKAGE_LIBEVDEV=y
BR2_PACKAGE_LIBINPUT=y

# Audio: ALSA direct (BASS and Unity both speak ALSA)
BR2_PACKAGE_ALSA_LIB=y
BR2_PACKAGE_ALSA_PLUGINS=y
BR2_PACKAGE_LIBSAMPLERATE=y
BR2_PACKAGE_ALSA_UTILS=y
BR2_PACKAGE_ALSA_UTILS_ALSAMIXER=y
BR2_PACKAGE_ALSA_UTILS_AMIXER=y
BR2_PACKAGE_ALSA_UTILS_AMIDI=y
BR2_PACKAGE_ALSA_UTILS_APLAY=y
BR2_PACKAGE_ALSA_UTILS_SPEAKER_TEST=y

# Bluetooth / WiFi
BR2_PACKAGE_DBUS=y
BR2_PACKAGE_BLUEZ5_UTILS=y
BR2_PACKAGE_BLUEZ5_UTILS_CLIENT=y
BR2_PACKAGE_BLUEZ5_UTILS_PLUGINS_HID=y
BR2_PACKAGE_BLUEZ5_UTILS_PLUGINS_HOG=y
# Bluetooth headphones/earbuds as a sound output: A2DP (SBC) through an ALSA plugin, no sound server
BR2_PACKAGE_BLUEZ5_UTILS_PLUGINS_AUDIO=y
BR2_PACKAGE_BLUEZ_ALSA=y
BR2_PACKAGE_IWD=y
BR2_PACKAGE_WIRELESS_REGDB=y

# Storage / utilities
BR2_PACKAGE_E2FSPROGS=y
BR2_PACKAGE_E2FSPROGS_RESIZE2FS=y
BR2_PACKAGE_DOSFSTOOLS=y
BR2_PACKAGE_EXFATPROGS=y
BR2_PACKAGE_NTFS_3G=y
BR2_PACKAGE_UTIL_LINUX=y
BR2_PACKAGE_UTIL_LINUX_BINARIES=y
BR2_PACKAGE_UTIL_LINUX_PARTX=y
BR2_PACKAGE_UTIL_LINUX_RFKILL=y
BR2_PACKAGE_UTIL_LINUX_LIBBLKID=y
BR2_PACKAGE_UNZIP=y
BR2_PACKAGE_JQ=y
BR2_PACKAGE_CA_CERTIFICATES=y
BR2_PACKAGE_OPENSSL=y
# The `openssl` command: the updater verifies the release signature (Ed25519) with it.
BR2_PACKAGE_LIBOPENSSL_BIN=y
BR2_PACKAGE_LIBCURL=y
BR2_PACKAGE_LIBCURL_OPENSSL=y
BR2_PACKAGE_LIBCURL_CURL=y

# Debug tools (move to a separate fragment for release images)
BR2_PACKAGE_EVTEST=y
BR2_PACKAGE_LINUXCONSOLETOOLS=y
BR2_PACKAGE_LINUXCONSOLETOOLS_JOYSTICK=y
BR2_PACKAGE_USBUTILS=y
BR2_PACKAGE_PCIUTILS=y
BR2_PACKAGE_MESA3D_DEMOS=y
BR2_PACKAGE_VULKAN_TOOLS=y

# YARGOS packages
# YARG itself is not in the image: it is downloaded on the device (and its release bundles proprietary parts that
# must not be redistributed). `YARGOS_WITH_YARG=1 tools/br.sh` makes a private test image that has it preloaded.
# BR2_PACKAGE_YARG is not set
BR2_PACKAGE_YARGOS_BRIDGE=y
BR2_PACKAGE_YARGOS_HOME=y

# Images
BR2_TARGET_ROOTFS_EXT2=y
BR2_TARGET_ROOTFS_EXT2_4=y
BR2_TARGET_ROOTFS_EXT2_SIZE="1500M"
BR2_PACKAGE_HOST_GENIMAGE=y
BR2_PACKAGE_HOST_DOSFSTOOLS=y
BR2_PACKAGE_HOST_MTOOLS=y
BR2_PACKAGE_HOST_E2FSPROGS=y
```

## package/yarg/Config.in
```kconfig
config BR2_PACKAGE_YARG
	bool "yarg (seed release)"
	depends on BR2_x86_64
	depends on BR2_TOOLCHAIN_USES_GLIBC
	help
	  Installs a pinned YARG Linux release as a seed under
	  /usr/share/yarg-seed. On first boot it is copied to the writable
	  data partition, where the updater manages newer releases.

	  The release bundles proprietary components (BASS, Discord SDK),
	  so images containing it must not be redistributed.

	  https://github.com/YARC-Official/YARG

comment "yarg needs a glibc toolchain"
	depends on BR2_x86_64
	depends on !BR2_TOOLCHAIN_USES_GLIBC
```

## package/yargos-bridge/Config.in
```kconfig
config BR2_PACKAGE_YARGOS_BRIDGE
	bool "yargos-bridge"
	depends on BR2_PACKAGE_HOST_RUSTC_TARGET_ARCH_SUPPORTS
	select BR2_PACKAGE_HOST_RUSTC
	help
	  Userspace bridges that turn instruments YARG cannot read on Linux
	  into virtual PS3 instruments (uhid) that it detects automatically:
	  Bluetooth Wiimote guitars and wired Xbox 360 drum kits.
```

## package/yargos-home/Config.in
```kconfig
config BR2_PACKAGE_YARGOS_HOME
	bool "yargos-home"
	depends on BR2_PACKAGE_HOST_RUSTC_TARGET_ARCH_SUPPORTS
	select BR2_PACKAGE_HOST_RUSTC
	select BR2_PACKAGE_DEJAVU
	select BR2_PACKAGE_DEJAVU_SANS
	help
	  The YARGOS session: boot splash, YARG launcher and the dashboard
	  (Wi-Fi, sound, Bluetooth, updates, songs, system) shown when YARG
	  is closed.
```
